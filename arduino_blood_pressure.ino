#include <Wire.h>

uint32_t current_millis;
uint32_t prev_millis;

volatile byte XEEPROM[256] = {0x00, 0x00, 0x00, 0x00, 0x00, 0x00, 0x00, 0x00, 0x00, 0x00, 0x00, 0x00, 0x00,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 0x00, 0x00 };
volatile byte rQ, rD;
volatile int data_count;
volatile int wrote;
volatile uint16_t count;
volatile uint8_t sys, dia, hr;

void setup()
{
  Serial.begin(115200);
  Wire.begin(0x50);
  Wire.onReceive(receiveEvent);
  Wire.onRequest(requestEvent);

  uint16_t counter = 0;
  while (counter <= 256)
  {
    XEEPROM[counter] = 0x00;
    counter++;
  }

}

void loop()
{
  current_millis = millis();

  if (current_millis - prev_millis > 5000)
  {
    prev_millis = current_millis;


    if (count == 0)
    {
      Serial.print(":::");
      Serial.print(data_count);
      Serial.print("  count--->");
      Serial.println(count);
    }
    else if (count == 35)
    {
      Serial.print("Blood Presure Data: ");
      Serial.print(sys);
      Serial.print("/");
      Serial.println(dia);
      Serial.println("");
    }
    else
    {
      Serial.println("error");
    }


    count = 0;
    //    uint16_t data_written = 0;
    //    while (data_written < 256)
    //    {
    //      Serial.print(data_written);
    //      Serial.print(": ");
    //      Serial.println(XEEPROM[data_written]);
    //      data_written++;
    //    }
  }
}

void requestEvent()
{
  //  //   Wire.receive();
  //  if (data_count == 1)
  //  {
  //    Wire.write(XEEPROM[rQ]);
  //  }
  //  //   rQ++;
}

void receiveEvent(int iData)
{
  data_count = iData;
  if ( iData > 0 )
  {
    while ( iData-- )
    {
      rQ = Wire.read();
      Serial.println(rQ);
      count++;

      if (count == 28)
      {
        sys = rQ;
      }
      if (count == 29)
      {
        dia = rQ;
      }
      if (count == 30)
      {
        hr = rQ;
      }

    }
  }
  //  if (data_count == 1)
  //  {
  //    rQ = Wire.read();
  //  }
  //  else if (data_count == 2)
  //  {
  //    rQ = Wire.read();
  //    rD = Wire.read();
  //    XEEPROM[rQ] = rD;
  //  }
}
